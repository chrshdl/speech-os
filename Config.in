## Config.in
```kconfig
source "$BR2_EXTERNAL_SPEECH_OS_PATH/package/python-speech/Config.in"
source "$BR2_EXTERNAL_SPEECH_OS_PATH/package/python-onnxruntime/Config.in"
source "$BR2_EXTERNAL_SPEECH_OS_PATH/package/python-piper-tts/Config.in"
source "$BR2_EXTERNAL_SPEECH_OS_PATH/package/python-rapidfuzz/Config.in"
source "$BR2_EXTERNAL_SPEECH_OS_PATH/package/python-sounddevice/Config.in"
source "$BR2_EXTERNAL_SPEECH_OS_PATH/package/rpi-firmware-start4/Config.in"
```

## package/python-onnxruntime/Config.in
```kconfig
config BR2_PACKAGE_PYTHON_ONNXRUNTIME_ARCH_SUPPORTS
	bool
	default y if BR2_aarch64 && BR2_TOOLCHAIN_USES_GLIBC

config BR2_PACKAGE_PYTHON_ONNXRUNTIME
	bool "python-onnxruntime"
	depends on BR2_PACKAGE_PYTHON3
	depends on BR2_PACKAGE_PYTHON_ONNXRUNTIME_ARCH_SUPPORTS
	depends on BR2_INSTALL_LIBSTDCPP
	depends on BR2_PACKAGE_PYTHON_NUMPY_ARCH_SUPPORTS
	depends on BR2_TOOLCHAIN_GCC_AT_LEAST_9 # python-numpy
	depends on BR2_HOST_GCC_AT_LEAST_9 # host-python-numpy
	select BR2_PACKAGE_PYTHON_NUMPY # runtime
	help
	  ONNX Runtime, a cross-platform inference engine for ONNX
	  models, with its Python API.

	  Installed from the official manylinux wheel for aarch64:
	  building ONNX Runtime from source fetches dozens of pinned
	  third-party projects at configure time, which a Buildroot
	  build cannot do.

	  https://onnxruntime.ai

comment "python-onnxruntime needs an aarch64 glibc toolchain w/ C++"
	depends on BR2_PACKAGE_PYTHON3
	depends on !BR2_PACKAGE_PYTHON_ONNXRUNTIME_ARCH_SUPPORTS || \
		!BR2_INSTALL_LIBSTDCPP
```

## package/python-piper-tts/Config.in
```kconfig
config BR2_PACKAGE_PYTHON_PIPER_TTS
	bool "python-piper-tts"
	depends on BR2_PACKAGE_PYTHON3
	depends on BR2_PACKAGE_PYTHON_ONNXRUNTIME_ARCH_SUPPORTS
	depends on BR2_INSTALL_LIBSTDCPP # python-onnxruntime
	depends on BR2_PACKAGE_PYTHON_NUMPY_ARCH_SUPPORTS
	depends on BR2_TOOLCHAIN_GCC_AT_LEAST_9 # python-numpy
	depends on BR2_HOST_GCC_AT_LEAST_9 # host-python-numpy
	select BR2_PACKAGE_PYTHON_NUMPY # runtime
	select BR2_PACKAGE_PYTHON_ONNXRUNTIME # runtime
	select BR2_PACKAGE_PYTHON3_UNICODEDATA # runtime
	help
	  Piper, a fast neural text to speech system that runs on a
	  Raspberry Pi, with its Python API. Its voices are separate
	  .onnx files.

	  Installed from the official manylinux wheel for aarch64, which
	  has espeak-ng, for the phonemes, linked into its extension.

	  https://github.com/OHF-Voice/piper1-gpl

comment "python-piper-tts needs an aarch64 glibc toolchain w/ C++"
	depends on BR2_PACKAGE_PYTHON3
	depends on !BR2_PACKAGE_PYTHON_ONNXRUNTIME_ARCH_SUPPORTS || \
		!BR2_INSTALL_LIBSTDCPP
```

## package/python-rapidfuzz/Config.in
```kconfig
config BR2_PACKAGE_PYTHON_RAPIDFUZZ
	bool "python-rapidfuzz"
	depends on BR2_PACKAGE_PYTHON3
	help
	  Rapid fuzzy string matching.

	  Installed as its pure Python implementation, which rapidfuzz
	  falls back to by itself when the C++ extension is absent.
	  Building the extension needs scikit-build-core, which
	  Buildroot does not package.

	  https://github.com/rapidfuzz/RapidFuzz
```

## package/python-sounddevice/Config.in
```kconfig
config BR2_PACKAGE_PYTHON_SOUNDDEVICE
	bool "python-sounddevice"
	depends on BR2_PACKAGE_PYTHON3
	depends on BR2_TOOLCHAIN_HAS_THREADS # portaudio
	select BR2_PACKAGE_PORTAUDIO # runtime, dlopen()ed
	select BR2_PACKAGE_PYTHON_CFFI # runtime
	help
	  Play and record sound with Python, using PortAudio.

	  https://python-sounddevice.readthedocs.io
```

## package/python-speech/Config.in
```kconfig
config BR2_PACKAGE_PYTHON_SPEECH
	bool "python-speech"
	depends on BR2_PACKAGE_PYTHON3
	depends on BR2_PACKAGE_PYTHON_ONNXRUNTIME_ARCH_SUPPORTS
	depends on BR2_PACKAGE_HOST_RUSTC_TARGET_ARCH_SUPPORTS # python-fastapi -> python-pydantic-core
	depends on BR2_TOOLCHAIN_HAS_FORTRAN # python-scipy
	select BR2_PACKAGE_PYTHON3_SSL # runtime, weather over https
	select BR2_PACKAGE_PYTHON3_UNICODEDATA # runtime
	select BR2_PACKAGE_PYTHON3_ZLIB # runtime, compressed LM .npz
	select BR2_PACKAGE_PYTHON_FASTAPI # runtime
	select BR2_PACKAGE_PYTHON_HTTPX # runtime
	select BR2_PACKAGE_PYTHON_NUMPY # runtime
	select BR2_PACKAGE_PYTHON_ONNXRUNTIME # runtime
	select BR2_PACKAGE_PYTHON_PIPER_TTS # runtime, --voice
	select BR2_PACKAGE_PYTHON_RAPIDFUZZ # runtime
	select BR2_PACKAGE_PYTHON_SCIPY # runtime
	select BR2_PACKAGE_PYTHON_SOUNDDEVICE # runtime
	select BR2_PACKAGE_PYTHON_UVICORN # runtime
	select BR2_PACKAGE_PYTHON_WEBSOCKETS # runtime, uvicorn's WebSocket support
	help
	  Streaming speech recognition service: backend.py from the
	  speech repository, its HTTP API and the browser client it
	  serves. The acoustic model, the language model and the voice
	  are not part of the package; they live on the /data partition.

	  https://github.com/chrshdl/speech
```

## package/rpi-firmware-start4/Config.in
```kconfig
config BR2_PACKAGE_RPI_FIRMWARE_START4
	bool "rpi-firmware-start4"
	depends on BR2_PACKAGE_RPI_FIRMWARE_VARIANT_PI4
	help
	  A newer Raspberry Pi 4 GPU firmware (start4.elf, fixup4.dat)
	  than Buildroot's rpi-firmware, which the boot partition
	  takes instead of its copies (genimage.cfg).
	  Buildroot's cannot start the VL805 USB controller of a Pi 4
	  with a May 2026 bootloader EEPROM.

	  https://github.com/raspberrypi/firmware
```
